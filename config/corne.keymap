/* ─── Corne's 8 extra keys — Direction B: layered 42 (per-layer outer column) ──
 * The outer pinky column + outer thumbs are no longer hardcoded identical on
 * every layer. Each layer supplies its own 8 outer keys via OUTER_<LayerName>;
 * layers that don't care use ___ (transparent) and inherit DEF underneath — so
 * the daily feel is unchanged, but Mirror (and future layers) can repurpose the
 * outer column. This is corne-only: base.keymap's shared 8-arg call signature
 * (row-halves) is untouched, so corneish_zen / planck / glove80 are unaffected.
 *
 * Outer position order: XLT XRT | XLM XRM | XLB XRB | XLH XRH
 * (P1 fix: the old dead X_RH=&kp RALT define is gone — the outer-right thumb is
 *  &smart_mouse, its real binding.)
 */

// Base — the daily outer column (identical bindings to the old constants).
#define OUTER_Base    &kp TAB, &kp BSLH, &mt LCTL ESC, &kp SQT, &kp LSHIFT, MAGIC_SHIFT, &kp LGUI, &smart_mouse
// Momentary layers inherit Base's outer column via transparency (___ = &trans).
#define OUTER_Nav     ___, ___, ___, ___, ___, ___, ___, ___
#define OUTER_Fn      ___, ___, ___, ___, ___, ___, ___, ___
#define OUTER_Num     ___, ___, ___, ___, ___, ___, ___, ___
#define OUTER_Sys     ___, ___, ___, ___, ___, ___, ___, ___
#define OUTER_Mouse   ___, ___, ___, ___, ___, ___, ___, ___
// One-handed numpad sublayer, reached from Mirror (see MirrorNum below).
#define MIRRORNUM 7
// Mirror — one-handed essentials on the ACTIVE hand's own outer column. Both
// hands are mirrored so whichever hand holds the mirror can reach them alone.
// (Space + the inner-thumb funcs still work: thumbs stay ___ -> inherit DEF.)
//   top  outer = Backspace       | mid outer = hold -> MIRRORNUM (one-handed digits)
//   bot  outer = sticky Shift     | thumb outer = Enter
// Hold the mid-outer pinky while on Mirror -> the active hand's 3x3 becomes a
// 7-8-9/4-5-6/1-2-3 numpad; the layer stays while the pinky is held, so the
// thumbs are free (you can drop the mirror chord and still type digits).
#define OUTER_Mirror  &kp BSPC, &kp BSPC, &mo MIRRORNUM, &mo MIRRORNUM, &sk LSHFT, &sk LSHFT, &kp RET, &kp RET

// Wrapper: prepend the layer's outer keys, then destructure 8 outer + 8 halves.
// The indirection (_CORNE_OUTER) forces OUTER_##name to expand before the
// positional split in _CORNE_LAYER.
#define ZMK_BASE_LAYER(name, LT, RT, LM, RM, LB, RB, LH, RH)                    \
    _CORNE_OUTER(name, OUTER_##name, LT, RT, LM, RM, LB, RB, LH, RH)
#define _CORNE_OUTER(...) _CORNE_LAYER(__VA_ARGS__)
#define _CORNE_LAYER(name, XLT, XRT, XLM, XRM, XLB, XRB, XLH, XRH,              \
                     LT, RT, LM, RM, LB, RB, LH, RH)                            \
    ZMK_LAYER(                                                                 \
        name,                                                                  \
        XLT LT RT XRT                                                          \
        XLM LM RM XRM                                                          \
        XLB LB RB XRB                                                          \
        XLH LH RH XRH                                                          \
    )

#include "dt-bindings/zmk/ext_power.h"
#include "dt-bindings/zmk/rgb.h"

&spi3 {
  led_strip: ws2812@0 {
    /* WS2812 */
    chain-length = <27>; /* There are per-key RGB, but the first 6 are underglow */
  };
};

#define CONFIG_WIRELESS

#include "zmk-helpers/key-labels/42.h"
#include "base.keymap"

// ─── MirrorNum (layer 7) — one-handed numpad ───────────────────────────────────
// Reached by holding the mid-outer pinky on Mirror (&mo MIRRORNUM above). Both
// hands carry an identical 7-8-9 / 4-5-6 / 1-2-3 numpad on their 3 middle columns
// (ring/middle/index), with 0 on the inner index column, so either active hand
// works. Number-ROW codes (N1..N0), not keypad, for cross-OS reliability. Outer
// column keeps Bspc / Shift / Enter; the mid-outer is the held activation (___).
// Defined via the same per-layer wrapper for outer-column consistency; this is
// the 8th ZMK_BASE_LAYER call -> index 7 == MIRRORNUM.
#define OUTER_MirrorNum  &kp BSPC, &kp BSPC, ___, ___, &sk LSHFT, &sk LSHFT, &kp RET, &kp RET
ZMK_BASE_LAYER(MirrorNum,
    ___ &kp N7 &kp N8 &kp N9 ___    ,   ___    &kp N7 &kp N8 &kp N9 ___    ,
    ___ &kp N4 &kp N5 &kp N6 &kp N0 ,   &kp N0 &kp N4 &kp N5 &kp N6 ___    ,
    ___ &kp N1 &kp N2 &kp N3 ___    ,   ___    &kp N1 &kp N2 &kp N3 ___    ,
                          ___ ___    ,   ___ ___
)

/{ chosen { zmk,physical-layout = &foostan_corne_6col_layout; }; };
